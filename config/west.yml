## config/west.yml
```yaml
manifest:
  remotes:
    - name: dxmh
      url-base: https://github.com/dxmh
  projects:
    - name: zmk
      remote: dxmh
      revision: tipper_tf_zephyr30
      import: app/west.yml
  self:
    path: config
```
